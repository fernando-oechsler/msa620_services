/dts-v1/;
/plugin/;

/ {
    compatible = "brcm,bcm2835";

    fragment@0 {
        target-path = "/";
        __overlay__ {
            msa620-gpio {
                compatible = "keyboard,msa620";
                status = "okay";

                row-gpios = <&gpio 6 16>,   	/* L1 */
                            <&gpio 21 16>,  	/* L2 */
                            <&gpio 20 16>,  	/* L3 */
                            <&gpio 16 16>,  	/* L4 */
                            <&gpio 19 16>,  	/* L5 */
                            <&gpio 13 16>;  	/* L6 */

                col-gpios = <&gpio 5 0>,    	/* C1 */
                            <&gpio 7 0>,    	/* C2 */
                            <&gpio 8 0>,    	/* C3 */
                            <&gpio 25 0>,   	/* C4 */
                            <&gpio 24 0>;   	/* C5 */

                ledtec-gpios = <&gpio 12 0>;    /* LED TECLADO */
                           
                ledcpu-gpios = <&gpio 26 0>;    /* LED CPU */         
            };
        };
    };
};
